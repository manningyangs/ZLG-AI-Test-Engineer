VERSION "corrupt_bad_syntax"
NS_ :

BS_:
BU_: ECM BCM
BO_ 256 BrokenMsg: 8 ECM
 SG_ Speed : 0|16@1+ (0.01,0) [0|655.35] "km/h" BCM
BO_ not_a_number SecondBroken: 8 ECM
 SG_ Bad : x|8@1+ (1,0) [0|255] "" BCM
